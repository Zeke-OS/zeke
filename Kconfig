## Kconfig
```kconfig
mainmenu "Zeke Configuration"

menu "Kernel"
source kern/Kconfig
endmenu

menu "boot"
source boot/Kconfig
endmenu

menu "bin"
source bin/Kconfig
endmenu

menu "etc"
source etc/Kconfig
endmenu

menu "lib"
source lib/Kconfig
endmenu

menu "sbin"
source sbin/Kconfig
endmenu

menu "usr"
source usr/Kconfig
endmenu

menu "opt"
source opt/Kconfig
endmenu
```

## boot/Kconfig
```kconfig
# boot/Kconfig

comment "Boot loader configuration"

# select this if the platform specific bootloader will prepare ATAGs.
config configHAVE_ATAGS
    bool
    default n

choice
    prompt "Boot loader selection"
    default configBOOTLOADER_RPI if configBCM2835 && !configQEMU_GUEST
    default configBOOTLOADER_NONE

config configBOOTLOADER_NONE
    bool "None"

config configBOOTLOADER_RPI
    bool "Raspberry Pi"
    depends on configBCM2835
    select configHAVE_ATAGS

config configBOOTLOADER_RPI0
    bool "Raspberry Pi Zero"
    depends on configBCM2835

endchoice
```

## etc/Kconfig
```kconfig
# etc/Kconfig

config configETC_TESTING
    bool "Enable testing configs"
    default n
```

## kern/Kconfig
```kconfig
# kern/Kconfig

comment "Kernel options"

source "kern/hal/Kconfig"

menu "Memory Management"

menu "Physical memory layout"

config configKSTACK_START
    hex "P kstack start"
    default 0x00001000
    range 0x00001000 0x00001000
    ---help---
    See configKSTACK_END.

config configKSTACK_END
    hex "P kstack end"
    default 0x00007fff
    range 0x00007fff 0x00007fff
    ---help---
    Kernel interrupt stacks used when the kernel enters to a kernel mode due to
    a received interrupt.

config configKERNEL_START
    hex "P kernel caddr start"
    default 0x00008000

config configKERNEL_END
    hex "P kernel caddr end"
    default 0x003fffff

config configPT_AREA_START
    hex "P Page table area start"
    default 0x00400000
    depends on configMMU

config configPT_AREA_END
    hex "P Page table area end"
    default 0x007FFFFF
    depends on configMMU

config configDYNMEM_START
    hex "P dynmem start"
    default 0x00800000
    ---help---
    Dynmem is the memory area used for dynamic memory allocations, for both
    memory used inside the kernel as well as memory passed to the user space.
    Though dynmem allocations are rarely used as such and some higher level
    memory allocator us used instead, eg. vralloc (buf.h).

config configDYNMEM_SIZE
    hex "dynmem size"
    default 0x800000
    ---help---
    Size of the dynmem memory area, must be less than the total available memory
    on the hardware.

endmenu

menu "Kernel virtual layout"

config configTKSTACK_START
    hex "V tkstack vaddr start"
    default 0x00001000
    range 0x00000000 0x00001000
    depends on configMMU
    ---help---
    See help on configTKSTACK_END.

config configTKSTACK_END
    hex "V tkstack vaddr end"
    default 0x00001fff
    range 0x00000fff 0x00001fff
    depends on configMMU
    ---help---
    Thread kernel stack starts from here. Currently this stack addr must be
    within the first megabyte of the virtual memory address space.

config configKSECT_START
    hex "V ksect start"
    default 0x30000000
    ---help---
        Ksects, kernel dynamic virtual sections, are mainly mainly used to
        access memory mapped IO by using strongly ordered access on
        the virtual ksect address.

config configKSECT_END
    hex "V ksect end"
    default 0x50000000
 
endmenu

menu "User process memory layout"

config configEXEC_BASE_LIMIT
    hex "Exec base address low limit"
    default 0x10000000
    ---help---
    Lowest base address allowed for loading sections from a binary file.

config configUENV_BASE_ADDR
    hex "Args & environ page base address"
    default 0x0FFFF000
    --help---
    Base address for process arguments and environment.

endmenu

endmenu

source "kern/sched/Kconfig"

menu "Processes"

config configMAXPROC
    int "maxproc"
    default 50
    ---help---
    Maximum number of processes in the system. The value should be big enough
    because it can't be changed on runtime.

config configPROC_STACK_DFL
    int "Stack default size"
    default 8192
    ---help---
    Default stack size of a new process main().

config configCOW_ENABLED
    bool "Enable copy-on-write for processes"
    default y
    ---help---
    Selects whether process memory regions shall be copied on demand as COW
    (Copy-On-Write) or immediately when a process is forked.

config configCORE_DUMPS
    bool "Core dump support"
    default y
    ---help---
    Add a core dump support for processes. If this feature is enabled a core
    dump support is added to the kernel and certain signals will cause a core
    dump to be stored by default.

    This should be enable normally. It might be necessary to disable this to
    get a minimal system or if a system has only read-only file systems.

menu "Default hard limits"

config configRLIMIT_CORE
    int "RLIMIT_CORE"
    default -1
    ---help---
    Maximum size of a core file, in bytes.

    -1 is no limit.

config configRLIMIT_CPU
    int "RLIMIT_CPU"
    default -1
    ---help---
    Max amount of CPU time limit.

    -1 is no limit.

config configRLIMIT_DATA
    int "RLIMIT_DATA"
    default -1
    ---help---
    Data segment size limit.

    -1 is no limit.

config configRLIMIT_FSIZE
    int "configRLIMIT_FSIZE"
    default -1
    ---help---
    File size limit of a process.

    -1 is no limit.

config configRLIMIT_NOFILE
    int "RLIMIT_NOFILE"
    range 8 1024
    default 16
    ---help---
    Limit on number of open files.

    Can't be infinite (-1).

config configRLIMIT_STACK
    int RLIMIT_STACK
    default -1
    ---help---
    Maximum size of stack for a thread, in bytes.

    -1 is no limit.

config configRLIMIT_AS
    int "RLIMIT_AS"
    default -1
    ---help---
    Limit on address space size of a process.

    -1 is no limit.

endmenu

endmenu


menu "Generic"

config configTIMERS_MAX
    int "Maximum number of kernel timers"
    default 128
    range 15 65535
    ---help---
    Maximum number of kernel timers available.

config configUSRINIT_SSIZE
    int "init stack size"
    default 8192
    ---help---
    Stack size for init process main() thread.

config configRCU_SYNC_HZ
    int "RCU synchronization interval [ms]"
    default 1000
    ---help---
    Automatic RCU synchronization runs once per interval set here, toggles the
    clock and reclaims any unreclaimed garbage assigned to the previus reclaim
    list.

    Set to 0 to disable automatic synchronization.

endmenu

menu "Kernel debugging"

config configKASSERT
    bool "Kernel asserts"
    default n
    ---help---
    Enable KASSERT asserts in the kernel. Selecting this option will slightly
    slow down the kernel.

config configKMEM_DEBUG
    bool "kmem debug"
    default n
    ---help---
    Enable kmem init debug messages.

config configVRALLOC_DEBUG
    bool "vralloc debug"
    default n
    ---help---
    Enable additional debugging assertions in vralloc.

config configLOCK_DEBUG
    bool "klock debugging"
    default n
    ---help---
    Debug kernel locks.

config configKLOCK_DLTHRES
    int "Klock deadlock detection threshold"
    default 19
    depends on configLOCK_DEBUG
    ---help---
    Try to detect spinlock deadlocks by using a try counter. Setting this option
    to zero disables the deadlock detection.

endmenu

source "kern/kerror/Kconfig"

source "kern/fs/Kconfig"


menu "Security"

config configSUSER
    bool "Enable super user privileges"
    default n
    ---help---
    Processes with uid 0 have privilege by default. This knob sets default value
    of suser_enabled sysctl variable to one.

    If suser_enabled is set to zero, uid 0 is offers no special privilege in
    the kernel security policy in most of the places. It can be also set at
    runtime by using sysctl interface.

    If unsure, say Y.

config configBOOT_SECURELEVEL
    int "Securelevel at boot"
    default 0

endmenu


source "kern/libkern/Kconfig"
source "kern/kunit/Kconfig"
```

## kern/fs/Kconfig
```kconfig
# kern/fs/Kconfig

menu "File Systems"

menu "Rootfs"

config configROOTFS_PATH
    string "FS path"
    default "/dev/emmc0p1"

config configROOTFS_NAME
    string "FS name"
    default "fatfs"

config configROOTFS_FLAGS
    int "Mount flags"
    default 0

config configROOTFS_PARMS
    string "Params"

endmenu

config configFS_DEBUG
    bool "fs subsystem debugging"
    default n

config configFS_VREF_DEBUG
    bool "fs vref debugging"
    default n

menuconfig configMBR
    bool "MBR Support"
    default y
    depends on configDEVFS
    ---help---
    Read MBR and populate devices for drive partitions accordingly.

menuconfig configRAMFS
    bool "ramfs"
    default y
    select configFS_DEHTABLE
    select configFS_INPOOL
    ---help---
    Provides in-RAM file system that can be used before hardware backed
    file systems are mounted. It also provides a mountpoint for pseudo
    file systems during boot. Some file systems may also inherit ramfs
    and thus auto select it.

if configRAMFS
config configRAMFS_DEBUG
    bool "Debugging"
    default n
endif

config configDEVFS
    bool "devfs"
    default y
    select configRAMFS
comment "No devfs"
    depends on !configDEVFS

menuconfig configPROCFS
    bool "procfs"
    default y
    select configRAMFS
    ---help---
    Provides a Plan 9 -like process file system.

source "kern/fs/fatfs/Kconfig"

menu "FS libs"

config configFS_INPOOL
    bool "inode pools"
    ---help---
    inode pool speeds up the creation of new inodes in file systems.
    A pool is used to get new preallocated inodes as well as destroying
    and recyling old inodes. A file system may have unlimited amount of
    pools as pools are handled as objects.

    This is usually auto selected.

config configFS_DEHTABLE
    bool "Dirent hash table"

config configVFS_HASH
    bool "VFS Hash"
    select configSUBR_HASH
    ---help---
    A vnode hashmap for file systems that have to cache vnode data in-core.

    This is usually auto selected.

config configVFS_HASH_CTX_MAX
    int "Max number of contexts"
    default 1
    depends on configVFS_HASH
    ---help---
    Maximum number of VFS hash contexts, ie. the number of file systems that
    are willing to allocate a VFS hash cotext.

endmenu

endmenu
```

## kern/fs/fatfs/Kconfig
```kconfig
menuconfig configFATFS
    bool "FatFs"
    default n
    select configFS_INPOOL
    select configVFS_HASH
    ---help---
    The FatFs driver will permit the kernel to read and write MS-DOS based
    file systems. This driver covers the FAT12, FAT16 and FAT32 file system
    versions.

    Some hardware platforms like raspberry may require a FAT boot partition,
    so this driver is useful for accessing that partiotion too.

if configFATFS

config configFATFS_DEFAULT_CODEPAGE
    int "Default code page for FAT"
    default 437
    ---help---
    This option sets the default OEM code page used for FAT file systems.
    Incorrect setting of the code page can cause a file open failure.

    The code page can be also selected dynamically by using the codepage mount
    parameter.

    At least the following code pages are supported:

    *  932  - Japanese Shift_JIS (DBCS, OEM, Windows)
    *  936  - Simplified Chinese GBK (DBCS, OEM, Windows)
    *  949  - Korean (DBCS, OEM, Windows)
    *  950  - Traditional Chinese Big5 (DBCS, OEM, Windows)
    *  1250 - Central Europe (Windows)
    *  1251 - Cyrillic (Windows)
    *  1252 - Latin 1 (Windows)
    *  1253 - Greek (Windows)
    *  1254 - Turkish (Windows)
    *  1255 - Hebrew (Windows)
    *  1256 - Arabic (Windows)
    *  1257 - Baltic (Windows)
    *  1258 - Vietnam (OEM, Windows)
    *  437  - U.S. (OEM)
    *  720  - Arabic (OEM)
    *  737  - Greek (OEM)
    *  775  - Baltic (OEM)
    *  850  - Multilingual Latin 1 (OEM)
    *  858  - Multilingual Latin 1 + Euro (OEM)
    *  852  - Latin 2 (OEM)
    *  855  - Cyrillic (OEM)
    *  866  - Russian (OEM)
    *  857  - Turkish (OEM)
    *  862  - Hebrew (OEM)
    *  874  - Thai (OEM, Windows)

config configFATFS_UNICODE
    bool "FAT Unicode support"
    default n

choice

    prompt "Directory entry offset 0x12"
    ---help---
        Since DOS 7.0 the offsets 0x12 and 0x13 have been used for saving the
        last access time (known as atime in Unix-like systems). However, atime
        is not a very popular file system feature these days and even DOS had it
        disabled by default (ACCDATE in CONFIG.SYS enabled it).

        FlexOS, 4680 OS, 4690 OS, DR-DOS and some other multi-user operating
        systems used these bytes for storing owner IDs.

        Zeke offers a choice between atime or storing UID and GID in these
        bytes.

config configFATFS_ACCDATE
    bool "ACCDATE"
    default y

config configFATFS_OWNER_ID
    bool "Owner ID"

endchoice

config configFATFS_DESIREDVNODES
    int "desiredvnodes"
    default 100
    ---help---
    Controls the vnode hash table size.
    This option should be set to the expected average maximum number of vnodes
    required by the whole fatfs driver.

config configFATFS_DEBUG
    bool "Debugging"
    default n

endif
```

## kern/fs/ramfs/Kconfig
```kconfig
menuconfig configRAMFS
    bool "ramfs"
    default y
    select configFS_DEHTABLE
    select configFS_INPOOL
    ---help---
    Provides in-RAM file system that can be used before hardware backed
    file systems are mounted. It also provides a mountpoint for pseudo
    file systems during boot. Some file systems may also inherit ramfs
    and thus auto select it.

if configRAMFS

config configRAMFS_DESIREDVNODES
    int "desiredvnodes"
    default 100
    ---help---
    Controls the vnode hash table size.
    This option should be set to the expected average maximum number of vnodes
    required by the whole ramfs driver.


config configRAMFS_DEBUG
    bool "Debugging"
    default n

endif
```

## kern/hal/Kconfig
```kconfig
# kern/hal/Kconfig

menu "HW features"

config configATAG
    bool "Support bootloader ATAGs"
    default y
    depends on configHAVE_ATAGS
    ---help---
        Linux ATAGs support. ATAGs are used to describe the current hardware
        configuration on some systems where a Linux compatible bootloader is
        involved.

        If unsure, say Y.

config configMP
    bool "Enable MP support"
    default n
    depends on configHAVE_MP_CAP
    ---help---
        Selecting configMP enables some MP safeguards but doesn't break anything
        even if MP is not actually supported on the hardware.

        If unsure, say Y.

config configMMU
    bool "MMU support"

config configMMU_DEBUG
    bool "MMU debugging"
    default n
    depends on configMMU
    ---help---
    Enable MMU debugging.

config configUART
    bool "UART support"
    default y
    select configDEVFS
    ---help---
    Have a unix-style devfs for accessing device drivers.

    If unsure, say Y.

if configUART

config configUART_MAX_PORTS
    int "Maximum number of UART ports"
    default 2
    range 1 256
    ---help---
    Maximum number of generic UART ports supported.

endif

source "kern/hal/emmc/Kconfig"

source "kern/hal/fb/Kconfig"

source "kern/hal/bcm2835/Kconfig"

source "kern/hal/rpi/Kconfig"

endmenu
```

## kern/hal/bcm2835/Kconfig
```kconfig
# kern/hal/bcm2835/Kconfig

menu "BCM drivers"

config configBCM_MB
    bool "BCM2835 mailbox support"
    default y if configBCM2835
    depends on configBCM2835

config configBCM_JTAG
    bool "BCM2835 JTAG support"
    default n
    depends on configBCM2835

config configBCM_FB
    bool "BCM2835 FB support"
    default n
    depends on configFB && configBCM2835 && configBCM_MB
    select configRPI_HW

config configBCM_PM
    bool "BCM2835 PM support"
    default n
    depends on configBCM2835 && configBCM_MB
    ---help---
    Enable BCM2835 Power Management support.

endmenu
```
