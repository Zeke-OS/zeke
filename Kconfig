## kern/hal/emmc/Kconfig
```kconfig
# kern/hal/emmc/Kconfig

# TODO Shouln't depend on BCM
menuconfig configEMMC
    bool "EMMC driver"
    depends on configBCM2835 && configBCM_MB
    default n

if configEMMC

config configEMMC_SD_1_8V_SUPPORT
    bool "Enable 1.8V support"
    default y

config configEMMC_SD_4BIT_DATA
    bool "Enable 4-bit support"
    default y

config configEMMC_SDXC_MAXIMUM_PERFORMANCE
    bool "Enable SDXC maximum performance mode"
    default n
    ---help---
        Enables SDXC maximum performance mode.
        This option requires 150 mA current.

        If unsure, say N.

config configEMMC_SDMA_SUPPORT
    bool "Enable SDMA support"
    default n

config configEMMC_SD_CARD_INTERRUPTS
    bool "Enable card interrupts"
    default n

config configEMMC_WRITE_SUPPORT
    bool "Enable SD card write support (EXPERIMENTAL)"
    default n
    ---help---
        Enable EXPERIMENTAL and possibly DANGEROUS SD card write support.

        If unsure, say N.

choice
    prompt "EMMC Implementation"
    default configEMMC_GENERIC if configQEMU_GUEST
    default configEMMC_BCM2708 if configBCM2835
    default configEMMC_GENERIC

config configEMMC_GENERIC
    bool "Generic EMMC"

config configEMMC_BCM2708
    bool "BCM2708 EMMC"
    depends on configBCM2835 && configBCM_MB && configBCM_PM

endchoice

config configEMMC_DEBUG
    bool "Debugging mode"
    default n

endif
```

## kern/hal/fb/Kconfig
```kconfig
# kern/hal/fb/Kconfig

menuconfig configFB
    bool "Frame Buffer support"
    default n

if configFB

config configFB_FONT_LATIN
    bool "Latin extension"
    default n

config configFB_FONT_GREEK
    bool "Greek extension"
    default n

config configFB_FONT_HIRAGANA
    bool "Hiragana extension"

endif
```

## kern/hal/rpi/Kconfig
```kconfig
# kern/hal/rpi/Kconfig

menu "Raspberry PI drivers"

config configRPI_HW
    bool "Raspberry PI memory mapped HW support"
    default n
    depends on configBCM2835

config configRPI_LEDS
    bool "Raspberry PI leds"
    default n
    depends on configBCM2835

endmenu
```

## kern/kerror/Kconfig
```kconfig
# kern/kerror/Kconfig

menuconfig configKLOGGER
    bool "Kernel logging facility"
    default y

if configKLOGGER
config configKERROR_BUF_SIZE
    int "Lastlog buf size"
    default 4096
config configKERROR_MAXLEN
    int "Max kerror line length"
    default 200

config configKERROR_UART
    bool "Direct UART0 printing support"
    default y
    depends on configUART

config configDEF_KLOGGER
    int "Default klogger method"
    range 0 3
    default 2
    ---help---
        0 = No logger
        1 = Kerror buffer
        2 = UART0

choice
    prompt "Log level"
    default configDEBUG_CRIT
config configDEBUG_CRIT
    bool "Normal build"
config configDEBUG_ERR
    bool "Errors"
    ---help---
        Additional error messages and asserts for serious errors that should not
        occur in normal operation.
config configDEBUG_WARN
    bool "Additional warnings"
config configDEBUG_INFO
    bool "Additional information"
    ---help---
        Additional information on warnings and errors.
config configDEBUG_DEBUG
    bool "Debug messages"
    ---help---
        All debug messages and asserts.
endchoice

endif
```

## kern/kunit/Kconfig
```kconfig
# kern/kunit/Kconfig

menuconfig configKUNIT
    bool "In-Kernel Unit Tests"
    depends on configPROCFS
    ---help---
    KUnit is a port of PUnit for in-kernel testing. KUnit is only needed
    if you are willing to run those tests. In-kernel tests may cause
    serious stability issues or crash the kernel.
    Tests are exported under sysctl debug.test tree and can be executed
    by writing to a test node. Test log is then written to the kernel
    logging facility.

if configKUNIT
config configKUNIT_REPORT_ORIENTED
    bool "Report oriented"

config configKUNIT_FS
    bool "fs"
    ---help---
    Tests for vfs and filesystems.

config configKUNIT_GENERIC
    bool "generic"
    ---help---
    Tests for generic data structures.

config configKUNIT_HAL
    bool "hal"
    ---help---
    Tests for HAL.

config configKUNIT_KSTRING
    bool "kstring"
    ---help---
    Tests for kstring library.

config configKUNIT_RCU
    bool "rcu"
    ---help---
    Tests for RCU subsystem.

config configKUNIT_VM
    bool "vm"
    ---help---
    Tests for virtual memory related libraries and subsystems.

endif
```

## kern/libkern/Kconfig
```kconfig
# kern/libkern/Kconfig

menu "Library routines"

config configGENSEGTREE
    bool "Generic min/max segment trees"
    default n
    ---help---
    Generic min/max segment tree implementation.

config configSUBR_HASH
    bool "Kernel hash tables"
    default n
    ---help---
    BSD kernel hash tables.

    See hashinit(9)

endmenu
```

## kern/sched/Kconfig
```kconfig
menu "Thread Scheduling"

config configSCHED_HZ
    int "Scheduler frequency in Hz"
    default 100
    range 5 1000

choice
    prompt "Load averages calculation period"
    default configSCHED_LAVGPERIOD_11SEC
config configSCHED_LAVGPERIOD_5SEC
    bool "5 sec"
config configSCHED_LAVGPERIOD_11SEC
    bool "11 sec"
endchoice

config configSCHED_TIME_AVG
    bool "Scheduling time average calculation"
    default y
    ---help---
        Enable scheduling time average calculation. If enabled the scheduler
        will provide the average time spent in a scheduler per CPU in sysctl.

config configSCHED_FREEQ_SIZE
    int "Free queue size"
    default 100
    ---help---
        Dead theads are freed in interrupt handler so the actually freeing of
        resources happens in the idle thread. This option controls the size of
        the queue to store garbage thread_info pointers.

endmenu
```

## opt/Kconfig
```kconfig
comment "Optional applications"

menu "Testing"

config configPU_REPORT_ORIENTED
    bool "Report oriented"
    default n
    ---help---
    Report oriented mode prints more additional information like test module and
    test case descriptions.

config configPU_UU
    bool "PUnit Unix Unit"
    default n

comment "Test Suites"

config configTESTS_FB
    bool "Framebuffer tests"
    default n

config configTESTS_LIBC
    bool "Libc unit tests"
    default n

config configTESTS_MMAN
    bool "Memory management tests (mmap)"
    default n

config configTESTS_TTY
    bool "TTY tests"
    default n

config configTESTS_PTHREAD
    bool "Pthread tests"
    default n

config configTESTS_UNISTD
    bool "Unistd tests"
    default n

endmenu
```
